## source-repo-biga/meta-aws-iot-automotive-demo/conf/layer.conf
```bitbake
# We have a conf and classes directory, add to BBPATH
BBPATH .= ":${LAYERDIR}"

# We have recipes-* directories, add to BBFILES
BBFILES += "${LAYERDIR}/recipes-*/*/*.bb \
            ${LAYERDIR}/recipes-*/*/*.bbappend"

# this is necessary to find aws-biga-image
BBFILES += "${LAYERDIR}/recipes-*/*/*/*.bb \
            ${LAYERDIR}/recipes-*/*/*/*.bbappend"

BBFILE_COLLECTIONS += "meta-aws-iot-automotive-demo"
BBFILE_PATTERN_meta-aws-iot-automotive-demo := "^${LAYERDIR}/"
BBFILE_PRIORITY_meta-aws-iot-automotive-demo = "99"

# This should only be incremented on significant changes that will
# cause compatibility issues with other layers
LAYERVERSION_meta-aws-iot-automotive-demo = "1"
LAYERSERIES_COMPAT_meta-aws-iot-automotive-demo = "kirkstone"
LAYERDEPENDS_meta-aws-iot-automotive-demo = "core meta-aws"

# The dynamic-layers directory hosts the extensions and layer specific
# modifications.
#
# The .bbappend and .bb files are included if the respective layer
# collection is available.
BBFILES += "${@' '.join('${LAYERDIR}/dynamic-layers/%s/recipes*/*/*.bbappend' % layer \
               for layer in BBFILE_COLLECTIONS.split())}"
BBFILES += "${@' '.join('${LAYERDIR}/dynamic-layers/%s/recipes*/*/*.bb' % layer \
               for layer in BBFILE_COLLECTIONS.split())}"

# this is necessary to allow overwrites of dynamic-layers in dynamic-layers
BBFILES += "${@' '.join('${LAYERDIR}/dynamic-layers/%s/dynamic-layers/*/recipes*/*/*.bbappend' % layer \
               for layer in BBFILE_COLLECTIONS.split())}"
BBFILES += "${@' '.join('${LAYERDIR}/dynamic-layers/%s/dynamic-layers/*/recipes*/*/*.bb' % layer \
               for layer in BBFILE_COLLECTIONS.split())}"

BBFILES_DYNAMIC += " \
    alb:${LAYERDIR}/dynamic-layers/alb/*/*/*.bb \
    alb:${LAYERDIR}/dynamic-layers/alb/*/*/*.bbappend \
"
```
